/*
 * Copyright (c) 2026
 *
 * SPDX-License-Identifier: MIT
 */

#include <behaviors.dtsi>
#include <dt-bindings/zmk/keys.h>

/ {
    keymap {
        compatible = "zmk,keymap";

        debug_layer {
            bindings = <
                &kp A    &kp B    &kp C
            >;
        };
    };
};

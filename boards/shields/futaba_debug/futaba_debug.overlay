/*
 * Debug overlay for the normal Futaba shield.
 *
 * Build with:
 * SHIELD="futaba futaba_debug"
 */

&iqs550 {
    poll-interval-ms = <20>;
    movement-divisor = <1>;
    scroll-divisor = <24>;
};

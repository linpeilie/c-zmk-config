## boards/shields/futaba/Kconfig.defconfig
```kconfig
if SHIELD_FUTABA

config ZMK_KEYBOARD_NAME
    default "Futaba"

config ZMK_POINTING
    default y

config I2C
    default y

endif
```

## boards/shields/futaba_c/Kconfig.defconfig
```kconfig
if SHIELD_FUTABA_C

config ZMK_KEYBOARD_NAME
    default "futaba-c"

config ZMK_POINTING
    default y

config I2C
    default y

endif
```

## boards/shields/futaba_debug/Kconfig.defconfig
```kconfig
if SHIELD_FUTABA_DEBUG

config ZMK_KEYBOARD_NAME
    default "Futaba Debug"

config I2C
    default y

config ZMK_POINTING
    default y

config ZMK_USB
    default y

config LOG
    default y

config LOG_PROCESS_THREAD_STARTUP_DELAY_MS
    default 3000

config LOG_BUFFER_SIZE
    default 16384

endif
```

## boards/shields/futaba_iqs550_flash/Kconfig.defconfig
```kconfig
if SHIELD_FUTABA_IQS550_FLASH

config I2C
    default y

config ZMK_USB
    default y

endif
```

## boards/shields/futaba_iqs550_flash/Kconfig.shield
```kconfig
config SHIELD_FUTABA_IQS550_FLASH
    def_bool $(shields_list_contains,futaba_iqs550_flash)
```

## dts/bindings/input/azoteq,iqs5xx-common.yaml
```yaml
properties:
  rdy-gpios:
    type: phandle-array
    description: "Data Ready pin for the Azoteq IQS5xx trackpad"

  reset-gpios:
    type: phandle-array
    description: "Reset pin for the Azoteq IQS5xx trackpad"

  one-finger-tap:
    type: boolean
    description: "Register single finger tap gestures and report them as a left click"

  press-and-hold:
    type: boolean
    description: "Register press and hold gestures and report them as a left click until released"

  press-and-hold-time:
    type: int
    description: "Time in ms (in addition to the tap time) it takes to register a press and hold gesture"
    default: 250

  two-finger-tap:
    type: boolean
    description: "Register two finger tap gestures and report them as a right click"

  scroll:
    type: boolean
    description: "Register and report scroll gestures, both vertical and horizontal scroll is supported"

  natural-scroll-x:
    type: boolean
    description: "Whether content should track finger movement when scrolling on the x axis."

  natural-scroll-y:
    type: boolean
    description: "Whether content should track finger movement when scrolling on the y axis."

  switch-xy:
    type: boolean
    description: "Flip x and y axes"

  flip-x:
    type: boolean
    description: "Invert the direction of the x axis"

  flip-y:
    type: boolean
    description: "Invert the direction of the y axis"

  bottom-beta:
    type: int
    description: |
      Amount of filtering applied at slow speeds.
      0: Most filtering, smoother, but laggier.
      255: Least filtering, least smooth, more responsive.
    default: 5

  stationary-threshold:
    type: int
    description: |
      How far a finger must move (in pixels) to not be considered stationary.
    default: 5

  startup-delay-ms:
    type: int
    description: |
      Delay before probing the IQS5xx app address after host boot. Some boards
      power the trackpad at the same time as the MCU, and the IQS5xx may not be
      ready for app-address I2C transactions immediately.
    default: 500

  startup-probe-timeout-ms:
    type: int
    description: |
      How long to retry probing the IQS5xx app address during driver startup.
    default: 2000

  startup-probe-interval-ms:
    type: int
    description: |
      Delay between IQS5xx app-address probe attempts during driver startup.
    default: 250

  poll-interval-ms:
    type: int
    description: |
      Poll interval used when rdy-gpios is omitted. This is intended for boards
      that only route I2C to the IQS5xx and cannot use interrupt-driven updates.
    default: 12

  scroll-divisor:
    type: int
    description: |
      Relative-motion units per wheel tick. Higher values make scrolling slower.
    default: 24

  movement-divisor:
    type: int
    description: |
      Relative-motion divisor for pointer movement. Higher values make cursor
      movement slower. A value of 1 reports raw IQS5xx relative movement.
    default: 1

  program-firmware:
    type: boolean
    description: |
      Program the bundled GR-Trackpad65 IQS550 firmware over the IQS5xx I2C
      bootloader during device init. This is intended for a one-shot flashing
      firmware, not for normal daily keyboard firmware.

  force-firmware-update:
    type: boolean
    description: |
      Program the bundled firmware even if the non-volatile configuration area
      already matches the bundled GR-Trackpad65 image.

  firmware-program-delay-ms:
    type: int
    description: |
      Delay before starting one-shot firmware programming. This lets USB logging
      enumerate before the writer performs long bootloader/I2C operations.
    default: 5000

  bootloader-poll-timeout-ms:
    type: int
    description: |
      How long the one-shot writer polls the IQS5xx bootloader address when no
      reset GPIO is available. Use a long value to allow manually toggling the
      IQS550 NRST pin after USB serial logging is connected.
    default: 1000

  bootloader-poll-interval-ms:
    type: int
    description: |
      Delay between bootloader poll attempts. Increase this on bring-up builds
      to keep physical I2C line faults readable in USB logs.
    default: 100
```
